## Kconfig.board
```kconfig
# black_f407ve board configuration

# Copyright (c) 2020 Intel Corporation
# SPDX-License-Identifier: Apache-2.0

config BOARD_STM32_F407VE
	bool "STM32 F407VE Development Board"
	depends on SOC_STM32F407XE
```

## Kconfig.defconfig
```kconfig
# black_f407ve board configuration

# Copyright (c) 2020 Intel Corporation
# SPDX-License-Identifier: Apache-2.0

if BOARD_STM32_F407VE

config BOARD
	default "stm32f407_vet6"

config SPI_STM32_INTERRUPT
	default y
	depends on SPI

endif # BOARD_STM32_F407VE
```
